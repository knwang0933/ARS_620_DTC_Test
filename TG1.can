/*@!Encoding:936*/

includes
{

}



variables
{
    dword phy_add_id  = 0x773;  //物理寻址
    dword response_id = 0x77B;  //响应地址
    message 0x001 g_Tx        = {dlc=0x08};
    message 0x001 g_Rx        = {dlc=0x08};
    enum PARMAETER
    {
          g_N_BS              = 75,  //流控帧完全过程时间
          g_N_CR              = 150,  //连续帧完全过程时间
          g_N_AS              = 25,   //CAN数据帧在链路层传输时间
          g_P2_client         = 150,  //
          g_P2Ex_client       = 5000,
          g_PADDING_BIT       = 0x00//填充位
    };
    struct DID_St//DID信息的结构体
    {
      word DID;
      byte dlc;
      byte Res_Data[50];
    };
}
void DTC_FrameworkPlaceholder(char testcaseName[], char dtcCode[], char dtcTitle[])
{
  testCaseTitle("ARS620_DTC", testcaseName);
  testStep("Info", "DTC Code: %s", dtcCode);
  testStep("Info", "DTC Topic: %s", dtcTitle);
  testStepPass("Framework", "Framework ready, trigger/monitor/judge to be implemented.");
}


testcase SYS_Init_PowerOn()
{
  testCaseTitle("1.SystemInit", "SYS_Init_PowerOn");
  testStep("Init", "Power on and network wakeup.");
  testStepPass("Init", "Init framework ready.");
}

testcase SYS_Init_DiagnosticSession()
{
  testCaseTitle("1.SystemInit", "SYS_Init_DiagnosticSession");
  testStep("Init", "Diagnostic connection and session switch.");
  testStepPass("Init", "Init framework ready.");
}

testcase SYS_Init_DTCPreconditionCheck()
{
  testCaseTitle("1.SystemInit", "SYS_Init_DTCPreconditionCheck");
  testStep("Init", "Check DTC test preconditions.");
  testStepPass("Init", "Init framework ready.");
}

testcase SYS_Init_ClearDTC()
{
  testCaseTitle("1.SystemInit", "SYS_Init_ClearDTC");
  testStep("Init", "Clear historical DTC before test run.");
  testStepPass("Init", "Init framework ready.");
}
testcase DTC_C00188() { DTC_FrameworkPlaceholder("DTC_C00188", "C00188", "DTC PRIVATE CAN BUSOFF"); }
testcase DTC_9C6200() { DTC_FrameworkPlaceholder("DTC_9C6200", "9C6200", "DTC ALIGNMENT NEVER DONE"); }
testcase DTC_9C6300() { DTC_FrameworkPlaceholder("DTC_9C6300", "9C6300", "DTC ALIGNMENT NOT OK"); }
testcase DTC_577B00() { DTC_FrameworkPlaceholder("DTC_577B00", "577B00", "DTC ONLINE CALIBRATION FAILED"); }
testcase DTC_9C6500() { DTC_FrameworkPlaceholder("DTC_9C6500", "9C6500", "DTC SENSOR FULL BLOCKAGE"); }
testcase DTC_577C87() { DTC_FrameworkPlaceholder("DTC_577C87", "577C87", "DTC LOST COMMUNICATION WITH ACU"); }
testcase DTC_577D87() { DTC_FrameworkPlaceholder("DTC_577D87", "577D87", "DTC LOST COMMUNICATION WITH ESC"); }
testcase DTC_578E87() { DTC_FrameworkPlaceholder("DTC_578E87", "578E87", "DTC LOST COMMUNICATION WITH SAS"); }
testcase DTC_578283() { DTC_FrameworkPlaceholder("DTC_578283", "578283", "DTC ACU CHECKSUM ERROR"); }
testcase DTC_578383() { DTC_FrameworkPlaceholder("DTC_578383", "578383", "DTC ESC CHECKSUM ERROR"); }
testcase DTC_578483() { DTC_FrameworkPlaceholder("DTC_578483", "578483", "DTC SAS CHECKSUM ERROR"); }
testcase DTC_578682() { DTC_FrameworkPlaceholder("DTC_578682", "578682", "DTC ACU ROLLING COUNTER ERROR"); }
testcase DTC_578782() { DTC_FrameworkPlaceholder("DTC_578782", "578782", "DTC ESC ROLLING COUNTER ERROR"); }
testcase DTC_578882() { DTC_FrameworkPlaceholder("DTC_578882", "578882", "DTC SAS ROLLING COUNTER ERROR"); }
testcase DTC_D21429() { DTC_FrameworkPlaceholder("DTC_D21429", "D21429", "DTC LONG ACCEL INVALID ERROR"); }
testcase DTC_D21329() { DTC_FrameworkPlaceholder("DTC_D21329", "D21329", "DTC LATERAL ACCEL INVALID ERROR"); }
testcase DTC_D20629() { DTC_FrameworkPlaceholder("DTC_D20629", "D20629", "DTC YAWRATE INVALID ERROR"); }
testcase DTC_D2A429() { DTC_FrameworkPlaceholder("DTC_D2A429", "D2A429", "DTC VEHSPEED INVALID ERROR"); }
testcase DTC_578D29() { DTC_FrameworkPlaceholder("DTC_578D29", "578D29", "DTC STEERWHEEL ANGLE INVALID ERROR"); }
testcase DTC_579E91() { DTC_FrameworkPlaceholder("DTC_579E91", "579E91", "DTC ARS VDY PARAMETER EXCEPTION"); }
testcase DTC_9C7C00() { DTC_FrameworkPlaceholder("DTC_9C7C00", "9C7C00", "DTC VEHICLE CONFIGURATION PARAMTER INVALID"); }
