/*@!Encoding:936*/

includes
{


//#pragma library ("..\T2_AES128_SeednKey.dll" )
//import long CalcKey(long seed);/*@!Encoding:936*/

}



variables
{
    dword phy_add_id  = 0x773;  //物理寻址
    dword response_id = 0x77B;  //响应地址
    message 0x001 g_Tx        = {dlc=0x08};
    message 0x001 g_Rx        = {dlc=0x08};
    enum PARMAETER
    {
          g_N_BS              = 75,  //流控帧完全过程时间
          g_N_CR              = 150,  //连续帧完全过程时间
          g_N_AS              = 25,   //CAN数据帧在链路层传输时间
          g_P2_client         = 150,  //
          g_P2Ex_client       = 5000,
          g_PADDING_BIT       = 0x00//填充位
    };
    struct DID_St//DID信息的结构体
    {
      word DID;
      byte dlc;
      byte Res_Data[50];
    };
}



void StrToByte(char str[],byte byt[],byte dlc)//str转ascll字节数组
{
  int i=0;
  for(i=0;i<dlc;i++)
  {
    byt[i]=(byte)str[i];
  }
}
void ByteToFill(byte byt[], byte to_byt[],byte dlc)
{
  int i=0;
  for(i=0;i<dlc;i++)
  {
    to_byt[i]=byt[i];
  }
}

//发送诊断报文
TxSVC(dword id ,dword dlc ,byte data[])
{
    int data_n,i,tp_data_n;
    byte tp_data[4096];
    data_n = tp_data_n = 0;
    g_Tx.id = id;
    g_Tx.dlc = 8;
    if(dlc > 0x00){
      if(dlc <= 0x07)
      {   
          g_Tx.byte(0) = dlc;
          for(data_n = 0; data_n < 7; data_n++)//SF.
          {  
              g_Tx.byte(data_n+1) = 0;
              g_Tx.byte(data_n+1) = data[data_n];
          }
          output(g_Tx);testCaseComment("Tx",g_Tx);
      }
      else if(0x08 <= dlc && dlc <= 0xfff)
      {
          g_Tx.byte(0) = 0x10 + (dlc>>8);
          g_Tx.byte(1) = dlc&0xff;
          for(data_n = 0; data_n < 6; data_n++)//FF.
          {
              g_Tx.byte(data_n+2) = data[data_n];
          }
          output(g_Tx);testCaseComment("Tx",g_Tx);
          for(i = data_n; i < (int)dlc; i++)
          {
              tp_data[tp_data_n] = data[i];
              tp_data_n++;
          }
          TxTPData(id, dlc, tp_data);
      }
    }
}

//发送连续帧
TxTPData( dword id, long dlc, byte data[])
{
    int cur_cf_number,cur_data_number; //连续帧总数、发送的数据总数
    int sent_cf_n;//已发送连续帧数
    int i,TempLen;
    dword cf_stmin;
    cur_cf_number = dlc/0x07;//初始值
    cur_data_number = dlc - 0x06;//初始值
    sent_cf_n = TempLen = 0;//初始值
    if(1 == testWaitForMessage(response_id, g_P2_client))
    {   
        testGetRxMsgData();
        g_Tx.byte(0) = 0x21;
        if(g_Rx.byte(0) == 0x30)//0x30
        {
            cf_stmin = g_Rx.byte(2)+1;
            while(sent_cf_n < cur_cf_number)
            { 
                for( i = 1; i <= 0x07; i++)
                {
                    if(TempLen < cur_data_number)
                    {
                        g_Tx.byte(i) = data[TempLen];
                        TempLen++;
                    }
                    else
                    {
                        g_Tx.byte(i) = g_PADDING_BIT;
                    }
                } 
                output(g_Tx);testCaseComment("Tx",g_Tx);
                sent_cf_n++;
                if(g_Tx.byte(0) == 0x2f)
                {
                    g_Tx.byte(0) = 0x1F;
                }  
                if(sent_cf_n < cur_cf_number)
                {
                    testWaitForTimeout(cf_stmin);//最后帧连续帧之前的连续帧间隔时间
                } 
                g_Tx.byte(0)++;
            }
        }
    }
}

//发送流控帧,0x30
TXFC(dword id, byte FC_State, byte BS, byte Stmin)
{
    g_Tx.id = id;
    g_Tx.dlc = 8;
    g_Tx.byte(0) = FC_State;//CTS\WAIT\OVFLW
    g_Tx.byte(1) = BS;//块大小
    g_Tx.byte(2) = Stmin;//最小间隔时间
    g_Tx.byte(3) = 0;
    g_Tx.byte(4) = 0;
    g_Tx.byte(5) = 0;
    g_Tx.byte(6) = 0;
    g_Tx.byte(7) = 0;
    output(g_Tx);
}

//返回报文
void testGetRxMsgData()
{
    testGetWaitEventMsgData(g_Rx);
    testCaseComment("Rx",g_Rx);
}

//接受解析报文数据，例：62F190...
GetRxData(byte dataRecord[],byte responsecode)
{
  if(g_Rx.byte(1) == responsecode )//单帧响应
  {
    int i;
    for(i=0;i<=g_Rx.byte(0);i++)
    {
      dataRecord[i]=g_Rx.byte(i);
    }
  }
  else if(g_Rx.byte(2) == responsecode )//多帧响应
  {
    
    int Lmum=0,FCNum=0;
    int i;
    i=0;Lmum=0;FCNum=0;
    for(i=0;i<7;i++)//首帧报文
    {
      dataRecord[Lmum]=g_Rx.byte(i+1);
      Lmum++;
    }
    TXFC(phy_add_id, 0x30, 0x08, 0x0A);//发送流控帧
    while(1)
    {
      if(1 == testWaitForMessage(response_id,150))//收到连续帧
      {
        byte expect_byte0;
          testGetRxMsgData();
        expect_byte0=(0x21+(Lmum-6)/7);
        while (expect_byte0>0x2F)
        {
          expect_byte0=expect_byte0-0x10;
        }
          if(g_Rx.byte(0)==expect_byte0)
          {
            int j=0;
            for(j=1;j<8;j++)
            {
              dataRecord[Lmum]=g_Rx.byte(j);
              i++;
              Lmum++;
            }
          }
          FCNum++;
          if(FCNum%8==0)//每8帧一个流控
          {
            TXFC(phy_add_id, 0x30, 0x08, 0x0A);//发送流控帧
          }
      }
      else//没收到连续帧停止检测
        break;
    }
  }
}

//发送10服务
TxSVC10(long id, byte dlc,byte service, byte subfunction)
{
    dword TempLen;
    byte TempData[4096];
    TempLen = 0;
    TempData[TempLen++]= service;
    TempData[TempLen++]= subfunction;
    TxSVC(id,dlc,TempData);
}

//发送11服务
TxSVC11(long id, byte dlc,byte service, byte subfunction)
{
    TxSVC10(id,dlc,service,subfunction);
}

//发送14服务
TxSVC14(long id, byte dlc,byte service, byte Data[])//14服务
{
  int i;
  dword TempLen;
  byte TempData[4096];
  TempLen = 0;
  TempData[TempLen++]= service;
  for(i=0;i<3;i++)
  {
    TempData[TempLen++]=Data[i];
  }
  TxSVC(id,dlc,TempData);
}

//发送19服务
TxSVC19(long id, byte dlc,byte service, byte subfunction,byte Status)
{
  dword TempLen;
  byte TempData[4096];
  TempLen = 0;
  TempData[TempLen++]= service;
  TempData[TempLen++]= subfunction;
  TempData[TempLen++]= Status;
  TxSVC(id,dlc,TempData);
}

//发送22服务
TxSVC22(dword id, byte dlc,byte service,word DID, dword parameter)
{
    dword TempLen;
    byte TempData[4096];
    TempLen = 0;
    TempData[TempLen++]= service;
    TempData[TempLen++]= (DID >> 8) & 0xff;
    TempData[TempLen++]= DID & 0xff;
    TempData[TempLen++]= (parameter>> 24) & 0xff;
    TempData[TempLen++]= (parameter>> 16) & 0xff;
    TempData[TempLen++]= (parameter>> 8) & 0xff;
    TempData[TempLen++]= (parameter) & 0xff;
    TxSVC(id,dlc,TempData);
}

//发送28服务
TxSVC28(long id, byte dlc,byte service, byte subfunction,byte Status)
{
  TxSVC19(id,dlc,service,subfunction,Status);
}

//发送2E服务
TxSVC2E_Req(dword id,byte service,word DID,dword DID_dlc,byte Data[])
{
  int i;
  dword TempLen,dlc;
  byte TempData[4096];
  TempLen = 0;
  TempData[TempLen++]= service;
  TempData[TempLen++]= (DID >> 8) & 0xff;
  TempData[TempLen++]= DID & 0xff;
  for(i=0;i<DID_dlc;i++)
  {
    TempData[TempLen++]=Data[i];
  }
  dlc=TempLen;
  TxSVC(id,dlc,TempData);
}

//发送31服务
TxSVC31_Abnormal(long id, byte dlc,byte service, byte subfunction)//31服务
{
    dword TempLen;
    byte TempData[4096];
    TempLen = 0;
    TempData[TempLen++]= service;
    TempData[TempLen++]= subfunction;
    TxSVC(id,dlc,TempData);
}

//发送31服务
TxSVC31(dword id,byte service,byte subfunction,word DID,dword DID_dlc,byte Data[])//31路由
{
  int i;
  dword TempLen,dlc;
  byte TempData[4096];
  TempLen = 0;
  TempData[TempLen++]= service;
  TempData[TempLen++]= subfunction;
  TempData[TempLen++]= (DID >> 8) & 0xff;
  TempData[TempLen++]= DID & 0xff;
  for(i=0;i<DID_dlc;i++)
  {
    TempData[TempLen++]=Data[i];
  }
  dlc=TempLen;
  TxSVC(id,dlc,TempData);
}

TxSVC2F_Req(dword id,byte service,word DID,dword DID_dlc,byte IOCtr,word COR,word CSR)//2E写
{
  byte Data[10];
  Data[0]=IOCtr;
  Data[1]=(COR >> 8) & 0xff;
  Data[2]=COR & 0xff;
  Data[3]=(CSR >> 8) & 0xff;
  Data[4]=CSR & 0xff;
  TxSVC2E_Req(id,service,DID,DID_dlc,Data);
}

//发送85服务
TxSVC85(long id, byte dlc,byte service, byte subfunction)//85 服务
{
  TxSVC10(id,dlc,service,subfunction);
}

//响应断言
RXResponseCodeJudge(byte responsecode[] ,dword id ,byte service)
{
  if(responsecode[0] == 0)//不需要响应
  {
    if(1 == testWaitForMessage(response_id,g_P2_client))
    {
        testGetRxMsgData();
        if(g_Rx.byte(0) >= 0x10 && g_Rx.byte(0) < 0x20)//收到首帧的正响应
          {
            TXFC(phy_add_id, 0x30, 0x08, 0x0A);//发送流控帧
          }
        testStepFail("fail1","%.2x 预期无响应",service);
    }
    else
    {
        testStepPass("pass","%.2x 不响应",service);
    }
  }
  else//需要回响应
  {
    if(1 == testWaitForMessage(response_id,g_P2_client))
    {
      testGetRxMsgData();
      if( g_Rx.byte(3)==0x78)
      {
        while(1)
        {
          if(1==testWaitForMessage(response_id,g_P2Ex_client))
          {
            testGetRxMsgData();
            if( g_Rx.byte(3)==0x78)
              continue;
            else
              break;
          }
          testStepFail("fail3","%.2x 无响应",service);
          break;
        }
      }
      if(responsecode[0] == service+0x40)//需要响应完整的正响应请求
      {
        if(g_Rx.byte(1) == responsecode[0] || g_Rx.byte(2) == responsecode[0])//返正响应
        {
          testStepPass("pass","%.2x 正响应",service);
          if(g_Rx.byte(0) >= 0x10 && g_Rx.byte(0) < 0x20)//收到首帧的正响应
          {
            TXFC(phy_add_id, 0x30, 0x08, 0x0A);//发送流控帧
            while(1)
            {
              if(1 == testWaitForMessage(response_id,150))//收到连续帧
              {
                  //连续帧
              }
              else//没收到连续帧停止检测
                break;
            }
          }
        }
        else if(g_Rx.byte(1) == 0x7F)
        {
          testStepFail("fail4","%.2x 返回否定响应:[0x%.2x] ,预计正响应",service,g_Rx.byte(3),responsecode[0]);
        }
      }
      else//需要负响应
      {
        if(g_Rx.byte(1) == 0x7F)//负响应
        {
            if(g_Rx.byte(3) == responsecode[0])
            {
                testStepPass("pass","%.2x 返回否定响应:[0x%.2x] ",service,g_Rx.byte(3));
            }
            else
            {
                testStepFail("fail2","%.2x 返回响应:[0x%.2x] ,预期响应:[0x%.2x]",service,g_Rx.byte(3),responsecode[0]);
            }
         }
         else
          {
            testStepFail("fail3","需要否定响应，但回复了肯定响应");
          }
      }
    }
    else//需要回复，却没回复响应帧
    {
        testStepFail("fail3","%.2x 无响应",service);
    }
  } 
}
RXMsgJudge(int exAPP,int exNM)//用于28服务报文收发判断
{
  int i=0,app=0,nm=0;
//  testWaitForTimeout(2000);
  i=0;app=0;nm=0;
  while(1)
  {
//    write("i=%d",i);
    if(i==20)
      break;
    if(1 == testWaitForMessage(4900))//
    {
      i++;
      testGetRxMsgData();
      if((g_Rx.id==0x58d)|(g_Rx.id==0x580))//网络管理报文
      {
        nm++;
      }
      else if((g_Rx.id!=0x773)&(g_Rx.id!=0x77b)&(g_Rx.id!=0x58d))//应用报文
      {
        app++;
      }
//      write("app=%d,nm=%d",app,nm);
    }
    else//长时间没收到报文
      break;
  }
  if((exAPP==0)&(exNM==0))
  {
    if((app==0)&(nm==0))
      testStepPass("pass","No APP and NM msg Rx,as expected");
    else
      testStepFail("fail2","Expected No APP and NM msg Rx,Fail");
  }
  if((exAPP==0)&(exNM==1))
  {
    if((app==0)&(nm>0))
      testStepPass("pass","NM Rx and APP no Rx,as expected");
    else 
      testStepFail("fail2","Expected NM msg Rx And APP no Rx,Fail");
  }
  if((exAPP==1)&(exNM==0))
  {
    if((app>0)&(nm==0))
      testStepPass("pass","APP Rx and NM no Rx,as expected");
    else 
      testStepFail("fail2","Expected APP msg Rx And NM no Rx,Fail");
  }
  if((exAPP==1)&(exNM==1))
  {
    if((app>0)&(nm>0))
      testStepPass("pass","APP Rx and NM Rx,as expected");
    else 
      testStepFail("fail2","Expected APP msg Rx And NM Rx,Fail");
  }
}
//
RXResponse31Judge(byte responsecode[] ,dword id,word did,byte dlc,byte data[],byte service)//31数据判断
{
  if(responsecode[0] == 0)//不需要响应
  {
    if(1 == testWaitForMessage(response_id,g_P2_client))
    {
      testGetRxMsgData();
      testStepFail("fail1","%.2x 有响应，预期无响应",service);
    }
    else
    {
      testStepPass("pass","%.2x 无响应",service);
    }
  }
  else//需要回响应
  {
    int k=0;
    int g_P2_client_2=g_P2_client;
    for(k=0;k<3;k++)
    {
      if(1 == testWaitForMessage(response_id,g_P2_client_2))
      {
        testGetRxMsgData();
        if( g_Rx.byte(3)==0x78)
        {
          while(1)
          {
            if(1==testWaitForMessage(response_id,g_P2Ex_client))
            {
              testGetRxMsgData();
              if( g_Rx.byte(3)==0x78)
                continue;
              else
                break;
            }
            testStepFail("fail3","%.2x 无响应",service);
            break;
          }
        }
        if(responsecode[0] == service+0x40)//需要响应完整的正响应请求
        {
          if(g_Rx.byte(1) == responsecode[0] || g_Rx.byte(2) == responsecode[0])//返正响应
          {
            int i=0;
            int NoFaile=0;
            byte dataRecord[50];
            if((g_Rx.byte(1) == responsecode[0] )|(g_Rx.byte(2) == responsecode[0]))//
            {
              GetRxData(dataRecord,responsecode[0]);//获取数据值
              for(i=3;i<3+dlc;i++)
              {
                write("dataRecord[i]=%x,data[i-3]=%x",dataRecord[i],data[i-3]);
                if(dataRecord[i]!=data[i-3])
                {
                  NoFaile=1;
                  testStepFail("fail1","%.X  不符合预期结果.",service);
                  break;
                }
              }
              if(NoFaile==0)
              {
                testStepPass("pass","%.X 符合预期结果. ",did);
                break;
              }
            }
          }
          else
          {
            testStepFail("fail1","返回负响应，预期正响应",service);
          }
          break ;
        }
        else//需要负响应
        {
          if(g_Rx.byte(1) == 0x7F)//负响应
          {
            if(g_Rx.byte(3) == 0x78)
            {
               g_P2_client_2=500;
               continue;
            }
            if(g_Rx.byte(3) == responsecode[0])
            {
                testStepPass("pass","%.2x 返回否定响应:[0x%.2x] ",service,g_Rx.byte(3));
                break;
            }
            else
            {
                testStepFail("fail2","%.2x 返回响应:[0x%.2x] ,预期响应:[0x%.2x]",service,g_Rx.byte(3),responsecode[0]);
                break;
            }
           }
          else 
          {
            testStepFail("fail3","预期负响应，返回正响应");
            break;
          }
          break ;
        }
      }
      else//需要回复，却没回复响应帧
      {
          testStepFail("fail3","%.2x 无响应",service);
      }
    }
  } 
}

//
RXResponseAPPNMRXJudge(byte responsecode[] ,dword id,int exAPP,int exNM)//28APP and NM Msg is Exist
{
  byte service =0x28;
  if(responsecode[0] == 0)//need no response
  {
    if(1 == testWaitForMessage(response_id,g_P2_client))
    {
        testGetRxMsgData();
        testStepFail("fail1","%.2x 返回响应，预期无响应",service);
    }
    else
    {
        testStepPass("pass","%.2x 无响应",service);
    }
  }
  else//need positive response
  {
    if(1 == testWaitForMessage(response_id,g_P2_client))
    {
      testGetRxMsgData();
      if( g_Rx.byte(3)==0x78)
      {
        while(1)
        {
          if(1==testWaitForMessage(response_id,g_P2Ex_client))
          {
            testGetRxMsgData();
            if( g_Rx.byte(3)==0x78)
              continue;
            else
              break;
          }
          testStepFail("fail3","%.2x 无响应",service);
          break;
        }
      }
      if(responsecode[0] == service+0x40)//需要响应完整的正响应请求
      {
        if(g_Rx.byte(1) == responsecode[0] || g_Rx.byte(2) == responsecode[0])//返正响应
        {
          testStepPass("pass","%.2x 返回正响应",service);
          testWaitForTimeout(10);
          RXMsgJudge(exAPP,exNM);//报文收发情况判断
        }
        else if(g_Rx.byte(1) == 0x7F)
        {
          testStepFail("fail4","%.2x 返回否定响应:[0x%.2x] 预期为正响应",service,g_Rx.byte(3),responsecode[0]);
        }
      }
      else//需要负响应
      {
        if(g_Rx.byte(1) == 0x7F)//负响应
        {
            if(g_Rx.byte(3) == responsecode[0])
            {
                testStepPass("pass","%.2x 返回否定响应:[0x%.2x] ",service,g_Rx.byte(3));
            }
            else
            {
                testStepFail("fail2","%.2x 返回响应:[0x%.2x] ,预期响应:[0x%.2x]",service,g_Rx.byte(3),responsecode[0]);
            }
         }
         else 
         {
           testStepFail("fail3","返回正响应，预期位负响应.");
         }
       }
    }
    else//需要回复，却没回复响应帧
    {
        testStepFail("fail3","%.2x 无响应",service);
    }
  } 
}

/// <0x10服务>
testcase UDS_0x10_01()
{
  byte res[5];
  testCaseTitle("10服务","UDS_0x10_01");
  res[0]=0x50;
  TxSVC10(phy_add_id,0x02,0x10,0x01);
  RXResponseCodeJudge(res,phy_add_id,0x10);
  testWaitForTimeout(500);
}

/// <0x10服务>
testcase UDS_0x10_81()
{
  byte res[5];
  testCaseTitle("10服务","UDS_0x10_81");
  res[0]=0x00;
  TxSVC10(phy_add_id,0x02,0x10,0x81);
  RXResponseCodeJudge(res,phy_add_id,0x10);
  testWaitForTimeout(500);
}

/// <0x10服务>
testcase UDS_0x10_NRC_13()
{
  byte res[5];
  testCaseTitle("10服务","UDS_0x10_NRC_13");
  res[0] = 0x13;
  TxSVC10(phy_add_id,0x01,0x10,0x01);
  RXResponseCodeJudge(res,phy_add_id,0x10);
  TxSVC10(phy_add_id,0x03,0x10,0x01);
  RXResponseCodeJudge(res,phy_add_id,0x10);
  testWaitForTimeout(500);
}

/// <0x10服务>
testcase UDS_0x10_NRC_12()
{
  byte res[5];
  testCaseTitle("10服务","UDS_0x10_NRC_12");
  res[0] = 0x12;
  TxSVC10(phy_add_id,0x02,0x10,0x00);
  RXResponseCodeJudge(res,phy_add_id,0x10);
  TxSVC10(phy_add_id,0x02,0x10,0xFF);
  RXResponseCodeJudge(res,phy_add_id,0x10);
  testWaitForTimeout(500);
}

/// <0x11服务>
testcase UDS_0x11_NRC_13()
{
  byte res[5]; 
  testCaseTitle("10服务","UDS_0x11_NRC_13");
  res[0] = 0x13;
  TxSVC11(phy_add_id,0x01,0x11,0x01);
  RXResponseCodeJudge(res,phy_add_id,0x11);
  TxSVC11(phy_add_id,0x03,0x11,0x01);
  RXResponseCodeJudge(res,phy_add_id,0x11);
  testWaitForTimeout(500);
}

/// <0x11服务>
testcase UDS_0x11_NRC_12()
{
  byte res[5]; 
  testCaseTitle("11服务","UDS_0x11_NRC_12");
  res[0] = 0x12;
  TxSVC11(phy_add_id,0x02,0x11,0x00);
  RXResponseCodeJudge(res,phy_add_id,0x11);
  TxSVC11(phy_add_id,0x02,0x11,0xFF);
  RXResponseCodeJudge(res,phy_add_id,0x11);
  testWaitForTimeout(500);
}

/// <0x14服务>
testcase UDS_0x14()
{
  byte res[5]; 
  byte Date_0x14[3]={0xFF,0xFF,0xFF};
  byte Date_0x14_Err[3]={0x00,0x00,0x00};
  testCaseTitle("14服务","UDS_0x14");
  res[0]=0x54;
  TxSVC14(phy_add_id,0x04,0x14,Date_0x14);
  RXResponseCodeJudge(res,phy_add_id,0x14);
  testWaitForTimeout(500);
}

/// <0x14服务>
testcase UDS_0x14_NRC_13()
{
  byte res[5]; 
  byte Date_0x14[3]={0xFF,0xFF,0xFF};
  byte Date_0x14_Err[3]={0x00,0x00,0x00};
  testCaseTitle("14服务","UDS_0x14_NRC_13");
  res[0] = 0x13;
  TxSVC14(phy_add_id,0x03,0x14,Date_0x14);
  RXResponseCodeJudge(res,phy_add_id,0x14);
  TxSVC14(phy_add_id,0x05,0x14,Date_0x14);
  RXResponseCodeJudge(res,phy_add_id,0x14);
  testWaitForTimeout(500);
}

/// <0x14服务>
testcase UDS_0x14_NRC_31()
{
  byte res[5]; 
  byte Date_0x14[3]={0xFF,0xFF,0xFF};
  byte Date_0x14_Err[3]={0x00,0x00,0x00};
  testCaseTitle("14服务","UDS_0x14_NRC_31");
  res[0] = 0x31;
  TxSVC14(phy_add_id,0x04,0x14,Date_0x14_Err);
  RXResponseCodeJudge(res,phy_add_id,0x14);
  testWaitForTimeout(500);
}

/// <0x19服务>
testcase UDS_0x19()
{
  byte res[5]; 
  testCaseTitle("19服务","UDS_0x19");
  res[0]=0x59;
  TxSVC19(phy_add_id,0x03,0x19,0x01,0x09);
  RXResponseCodeJudge(res,phy_add_id,0x19);
  testWaitForTimeout(500);
}

/// <0x19服务>
testcase UDS_0x19_NRC_12()
{
  byte res[5]; 
  testCaseTitle("19服务","UDS_0x19_NRC_12");
  res[0]=0x12;
  TxSVC19(phy_add_id,0x03,0x19,0x00,0x09);
  RXResponseCodeJudge(res,phy_add_id,0x19);
}

/// <0x19服务>
testcase UDS_0x19_NRC_13()
{
  byte res[5]; 
  testCaseTitle("19服务","UDS_0x19_NRC_13");
  res[0]=0x13;
  TxSVC19(phy_add_id,0x02,0x19,0x01,0x09);
  RXResponseCodeJudge(res,phy_add_id,0x19);
  TxSVC19(phy_add_id,0x04,0x19,0x01,0x09);
  RXResponseCodeJudge(res,phy_add_id,0x19);
  testWaitForTimeout(500);
}

/// <0x22服务>
testcase UDS_0x22_F198()
{
  byte res[5]; 
  struct DID_st DID_F198;
  char DID_60D4_Str[50]="15173155441";
  DID_F198.DID=0xF198;
  DID_F198.dlc=18;
  StrToByte(DID_60D4_Str,DID_F198.Res_Data,DID_F198.dlc);
  testCaseTitle("22服务","UDS_0x22_F198");
  res[0]=0x62;
  TxSVC22(phy_add_id,0x03,0x22,0xF198,0x00);
  RXResponseCodeJudge(res,phy_add_id,0x22);
}
//
/// <0x28服务>
testcase UDS_0x28()
{
  byte res[5]; 
  testCaseTitle("28服务","UDS_0x28");
  res[0]=0x68;
  TxSVC10(phy_add_id,0x02,0x10,0x03);
  testWaitForTimeout(200);
  TxSVC28(phy_add_id,0x03,0x28,0x03,01); //Msg OFF
  RXResponseAPPNMRXJudge(res,phy_add_id,0,1);
  TxSVC28(phy_add_id,0x03,0x28,0x00,01); //Msg ON
  RXResponseAPPNMRXJudge(res,phy_add_id,1,1);
  testWaitForTimeout(500);
}

/// <0x28服务>
testcase UDS_0x28_NRC_7F()
{
  byte res[5]; 
  testCaseTitle("28服务","UDS_0x28_NRC_7F");
  res[0]=0x7F;
  TxSVC10(phy_add_id,0x02,0x10,0x01);
  testWaitForTimeout(200);
  TxSVC28(phy_add_id,0x03,0x28,0x03,0x01);
  RXResponseAPPNMRXJudge(res,phy_add_id,0,1);
  TxSVC28(phy_add_id,0x03,0x28,0x00,0x01);
  RXResponseAPPNMRXJudge(res,phy_add_id,1,1);
  testWaitForTimeout(500);
}

/// <0x28服务>
testcase UDS_0x28_NRC_12()
{
  byte res[5]; 
  testCaseTitle("28服务","UDS_0x28_NRC_12");
  res[0]=0x12;
  TxSVC10(phy_add_id,0x02,0x10,0x03);
  testWaitForTimeout(200);
  TxSVC28(phy_add_id,0x03,0x28,0xFF,0x01);
  RXResponseAPPNMRXJudge(res,phy_add_id,0,1);
  TxSVC28(phy_add_id,0x03,0x28,0xFF,0x01);
  RXResponseAPPNMRXJudge(res,phy_add_id,1,1);
  testWaitForTimeout(500);
}

/// <0x28服务>
testcase UDS_0x28_NRC_13() 
{
  byte res[5]; 
  testCaseTitle("28服务","UDS_0x28_NRC_13");
  res[0]=0x13;
  TxSVC10(phy_add_id,0x02,0x10,0x03);
  testWaitForTimeout(200);
  TxSVC28(phy_add_id,0x04,0x28,0x03,0x01);
  RXResponseAPPNMRXJudge(res,phy_add_id,0,1);
  TxSVC28(phy_add_id,0x02,0x28,0x00,0x01);
  RXResponseAPPNMRXJudge(res,phy_add_id,1,1);
  testWaitForTimeout(500);
}

/// <0x28服务>
testcase UDS_0x28_NRC_31() 
{
  byte res[5]; 
  testCaseTitle("28服务","UDS_0x28_NRC_31");
  res[0]=0x31;
  TxSVC10(phy_add_id,0x02,0x10,0x03);
  testWaitForTimeout(200);
  TxSVC28(phy_add_id,0x03,0x28,0x03,0xFF);
  RXResponseAPPNMRXJudge(res,phy_add_id,0,1);
  TxSVC28(phy_add_id,0x03,0x28,0x00,0xFF);
  RXResponseAPPNMRXJudge(res,phy_add_id,1,1);
  testWaitForTimeout(500);
}

/// <0x2E服务>
testcase UDS_0x2E_NRC_33()
{
  byte res[5]; 
  struct DID_st did_60D3;
  char DID_60D3_Str[50]="15173155441";
  struct DID_st did_60DE;
  did_60D3.DID=0x60D3;
  did_60D3.dlc=18;
  StrToByte(DID_60D3_Str,did_60D3.Res_Data,did_60D3.dlc);
  did_60DE.DID=0x60DE;
  did_60DE.dlc=1;
  did_60DE.Res_Data[0]=0;
  testCaseTitle("2E服务","UDS_0x2E_NRC_33");
  TxSVC10(phy_add_id,0x02,0x10,0x03);
  testWaitForTimeout(200);
  TxSVC2E_Req(phy_add_id,0x2E,did_60D3.DID,0x05,did_60D3.Res_Data);
  res[0]=0x33;
  RXResponseCodeJudge(res,phy_add_id,0x2E);
  testWaitForTimeout(500);
}

/// <0x2F服务>
testcase UDS_0x2F_NRC_11()
{
  byte res[5]; 
  struct DID_st did_0200;
  char DID0x0200_Str[50]="0300010001";
  did_0200.DID=0x0200;
  did_0200.dlc=5;
  StrToByte(DID0x0200_Str,did_0200.Res_Data,did_0200.dlc);
  testCaseTitle("2F服务","UDS_0x2F_NRC_11");
  TxSVC2F_Req(phy_add_id,0x2F,did_0200.DID,did_0200.dlc,0x00,0x0000,0x0000);
  res[0]=0x11;
  RXResponseCodeJudge(res,phy_add_id,0x2F);
  testWaitForTimeout(500);
}

/// <0x31服务>
testcase UDS_0x31_NRC_13()//Communication Test
{
  byte res[5]; 
  struct DID_st did_ED05;
  byte byt_ED05[4]={0x70,0x50,0x18,0x49};//IP地址
  did_ED05.DID=0xED05;
  did_ED05.dlc=4;
  ByteToFill(byt_ED05, did_ED05.Res_Data,did_ED05.dlc);
  testCaseTitle("31服务","UDS_0x31_NRC_13");
  TxSVC10(phy_add_id,0x02,0x10,0x03);
  testWaitForTimeout(200);
  TxSVC31_Abnormal(phy_add_id,0x02,0x31,0x01);
  res[0]=0x13;
  did_ED05.Res_Data[0]=0xED;
  did_ED05.Res_Data[1]=0xFF;
  did_ED05.Res_Data[2]=0xFF;
  RXResponse31Judge(res,phy_add_id,did_ED05.DID,0x03,did_ED05.Res_Data,0x31);
  testWaitForTimeout(500);
}

/// <0x31服务>
testcase UDS_0x31_NRC_7F()
{
  byte res[5]; 
  struct DID_st did_ED05;
  byte byt_ED05[4]={0x70,0x50,0x18,0x49};//IP地址
  did_ED05.DID=0xED05;
  did_ED05.dlc=4;
  ByteToFill(byt_ED05, did_ED05.Res_Data,did_ED05.dlc);
  testCaseTitle("31服务","UDS_0x31_NRC_7F");
  TxSVC10(phy_add_id,0x02,0x10,0x01);
  testWaitForTimeout(200);
  TxSVC31(phy_add_id,0x31,0x01,did_ED05.DID,0x05,did_ED05.Res_Data);
  res[0]=0x7F;
  did_ED05.Res_Data[0]=0xED;
  did_ED05.Res_Data[1]=0xFF;
  did_ED05.Res_Data[2]=0xFF;
  RXResponse31Judge(res,phy_add_id,did_ED05.DID,0x03,did_ED05.Res_Data,0x31);
  testWaitForTimeout(500);
}

/// <0x31服务>
testcase UDS_0x31_NRC_33()
{
  byte res[5]; 
  struct DID_st did_ED05;
  byte byt_ED05[4]={0x70,0x50,0x18,0x49};//IP地址
  did_ED05.DID=0xED05;
  did_ED05.dlc=4;
  ByteToFill(byt_ED05, did_ED05.Res_Data,did_ED05.dlc);
  testCaseTitle("31服务","UDS_0x31_NRC_33");
  TxSVC10(phy_add_id,0x02,0x10,0x03);
  testWaitForTimeout(200);
  TxSVC31(phy_add_id,0x31,0x01,did_ED05.DID,0x05,did_ED05.Res_Data);
  res[0]=0x33;
  did_ED05.Res_Data[0]=0xED;
  did_ED05.Res_Data[1]=0xFF;
  did_ED05.Res_Data[2]=0xFF;
  RXResponse31Judge(res,phy_add_id,did_ED05.DID,0x03,did_ED05.Res_Data,0x31);
  testWaitForTimeout(500);
}

/// <0x85服务>
testcase UDS_0x85() 
{
  byte res[5]; 
  testCaseTitle("85服务","UDS_0x85");
  TxSVC10(phy_add_id,0x02,0x10,0x03);
  testWaitForTimeout(500);
  res[0]=0xC5;
  TxSVC85(phy_add_id,0x02,0x85,0x02);
  RXResponseCodeJudge(res,phy_add_id,0x85);
  testWaitForTimeout(500);
}

/// <0x85服务>
testcase UDS_0x85_NRC_7F() 
{
  byte res[5]; 
  testCaseTitle("85服务","UDS_0x85_NRC_7F");
  TxSVC10(phy_add_id,0x02,0x10,0x01);
  testWaitForTimeout(150);
  res[0]=0x7F;
  TxSVC85(phy_add_id,0x02,0x85,0x02);
  RXResponseCodeJudge(res,phy_add_id,0x85);
}

/// <0x85服务>
testcase UDS_0x85_NRC_12() 
{
  byte res[5]; 
  testCaseTitle("85服务","UDS_0x85_NRC_12");
  TxSVC10(phy_add_id,0x02,0x10,0x03);
  testWaitForTimeout(150);
  res[0]=0x12;
  TxSVC85(phy_add_id,0x02,0x85,0xFF);
  RXResponseCodeJudge(res,phy_add_id,0x85);
}

/// <0x85服务>
testcase UDS_0x85_NRC_13()
{
  byte res[5]; 
  testCaseTitle("85服务","UDS_0x85_NRC_13");
  TxSVC10(phy_add_id,0x02,0x10,0x03);
  testWaitForTimeout(150);
  res[0]=0x13;
  TxSVC85(phy_add_id,0x03,0x85,0x02);
  RXResponseCodeJudge(res,phy_add_id,0x85);
}